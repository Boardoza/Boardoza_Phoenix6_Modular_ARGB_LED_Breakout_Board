#include <Arduino.h>
#include "T3A33BRG.h"

#define DATA_PIN   25
#define CLOCK_PIN  26
#define NUM_LEDS   12

T3A33BRG strip(DATA_PIN, CLOCK_PIN);

/**
 * @brief Starts a new frame by sending a special 32-bit pattern to the LED controller.
 *
 * This function sends a special 32-bit pattern to the LED controller to mark the start of a new
 * frame. The pattern consists of 3 bits of flag data, 5 bits of dimming data, and 24 bits of
 * color data (8 bits each for red, green, and blue).
 */
void startFrame() {
  strip.send32Bit(0, 0, 0, 0, 0);
}

/**
 * @brief Latches the current frame by sending 8 clock pulses to the LED controller.
 *
 * This function sends 8 clock pulses to the LED controller to latch the current frame. The
 * clock pulses are generated by setting the clock pin high, waiting for 1 microsecond, setting
 * the clock pin low, and waiting for another microsecond.
 */
void latchFrame() {
  digitalWrite(DATA_PIN, HIGH);
  for (uint8_t i = 0; i < 8; i++) {
    digitalWrite(CLOCK_PIN, HIGH);
    delayMicroseconds(1);
    digitalWrite(CLOCK_PIN, LOW);
    delayMicroseconds(1);
  }
}

void setup() {
  strip.begin();
}

/**
 * @brief Starts lighting up the LEDs one by one.
 *
 * This function starts lighting up the LEDs one by one. Each LED stays lit for 100
 * milliseconds, creating a "scanner" effect.
 */
void loop() {
  for (int8_t i = 0; i < NUM_LEDS; i++) {
    startFrame();
    for (uint8_t j = 0; j < NUM_LEDS; j++) {
      if (j == i)
        strip.send32Bit(0x07, 0x1F, 0, 0, 255);
      else
        strip.send32Bit(0x07, 0x00, 0, 0, 0);
    }
    latchFrame();
    delay(100);
  }
  // Reverse
  for (int8_t i = NUM_LEDS - 2; i > 0; i--) {
    startFrame();
    for (uint8_t j = 0; j < NUM_LEDS; j++) {
      if (j == i)
        strip.send32Bit(0x07, 0x1F, 0, 0, 255);
      else
        strip.send32Bit(0x07, 0x00, 0, 0, 0);
    }
    latchFrame();
    delay(100);
  }
}