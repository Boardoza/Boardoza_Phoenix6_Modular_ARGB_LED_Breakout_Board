#include <Arduino.h>
#include "T3A33BRG.h"

#define DATA_PIN   25
#define CLOCK_PIN  26
#define NUM_LEDS   12

T3A33BRG strip(DATA_PIN, CLOCK_PIN);

/**
 * @brief Starts a new frame by sending a special 32-bit pattern to the LED controller.
 *
 * This function sends a special 32-bit pattern to the LED controller to mark the start of a new
 * frame. The pattern consists of 3 bits of flag data, 5 bits of dimming data, and 24 bits of
 * color data (8 bits each for red, green, and blue).
 */
void startFrame() {
  strip.send32Bit(0, 0, 0, 0, 0);
}

/**
 * @brief Latches the current frame by sending 8 clock pulses to the LED controller.
 *
 * This function sends 8 clock pulses to the LED controller to latch the current frame. The
 * clock pulses are generated by setting the clock pin high, waiting for 1 microsecond, setting
 * the clock pin low, and waiting for another microsecond.
 */
void latchFrame() {
  digitalWrite(DATA_PIN, HIGH);
  for (uint8_t i = 0; i < 8; i++) {
    digitalWrite(CLOCK_PIN, HIGH);
    delayMicroseconds(1);
    digitalWrite(CLOCK_PIN, LOW);
    delayMicroseconds(1);
  }
}

void setup() {
  strip.begin();
}

/**
 * @brief Runs the Theater Chase animation.
 *
 * This function runs the Theater Chase animation, which cycles through 3 phases of
 * lighting up every 3rd LED with green light. The animation runs indefinitely.
 */
void loop() {
  for (uint8_t phase = 0; phase < 3; phase++) {
    startFrame();
    for (uint8_t i = 0; i < NUM_LEDS; i++) {
      if ((i + phase) % 3 == 0)
        strip.send32Bit(0x07, 0x01, 0, 255, 0);  // green
      else
        strip.send32Bit(0x07, 0x00, 0, 0, 0);     // off
    }
    latchFrame();
    delay(150);
  }
}